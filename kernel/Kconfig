## kernel/Kconfig
```kconfig
menu "KernelSU"

config KSU
	tristate "KernelSU function support"
	depends on OVERLAY_FS
	default y
	help
	  Enable kernel-level root privileges on Android System.
	  To compile as a module, choose M here: the
	  module will be called kernelsu.

config KSU_DEBUG
	bool "KernelSU debug mode"
	depends on KSU
	default n
	help
	  Enable KernelSU debug mode.

menu "KernelSU - SUSFS"
config KSU_SUSFS
    bool "KernelSU addon - SUSFS"
    depends on KSU
    default y
    help
      Patch and Enable SUSFS to kernel with KernelSU.

config KSU_SUSFS_SUS_PATH
    bool "Enable to hide suspicious path (NOT recommended)"
    depends on KSU_SUSFS
    default y
    help
      - Allow hiding the user-defined path and all its sub-paths from various system calls.
      - Effective on process with uid > 2000 only.
      - Use with cautious as it may cause performance loss and will be vulnerable to side channel attacks,
        just disable this feature if it doesn't work for you or you don't need it at all.

config KSU_SUSFS_SUS_MOUNT
    bool "Enable to hide suspicious mounts"
    depends on KSU_SUSFS
    default y
    help
      - Allow hiding the user-defined mount paths from /proc/self/[mounts|mountinfo|mountstat].
      - Effective on all processes for hiding mount entries.
      - The mnt_id, parent_mnt_id and mnt_group_id will be reordered as well in mountinfo while the actual values are remained unchanged in kernel,
        and this reorder function will be effective on all processes spawned only by the zygote process.

config KSU_SUSFS_TRY_UMOUNT
    bool "Enable to use ksu's try_umount"
    depends on KSU_SUSFS
    default y
    help
      - Allow using ksu's umount to umount other user-defined mount paths prior to ksu's default umount paths.
      - Effective on all NO-root-access-granted processes.
      
config KSU_SUSFS_ENABLE_LOG
    bool "Enable logging susfs log to kernel"
    depends on KSU_SUSFS
    default y
    help
      - Allow logging susfs log to kernel, uncheck it to completely disable all susfs log.

config KSU_SUSFS_SPOOF_BOOTCONFIG
    bool "Enable to spoof /proc/bootconfig"
    depends on KSU_SUSFS
    default y
    help
      - Spoof the output of /proc/bootconfig with a user-defined file.
      - Effective on all processes.

endmenu
endmenu
```
